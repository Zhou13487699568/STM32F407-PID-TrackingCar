#include "oled.h"
#include <stdio.h>
#include <string.h>
const uint8_t ascii_code_8x16[][16] = 
{
		/*字宽16,字高16-----对应英文宽比8x16*/
		
		{0x00,0x00,0x00,0x00,0x00,0x00,0x00,0x00,0x00,0x00,0x00,0x00,0x00,0x00,0x00,0x00},/*" ",0*/

		{0x00,0x00,0x00,0xF8,0x00,0x00,0x00,0x00,0x00,0x00,0x00,0x33,0x00,0x00,0x00,0x00},/*"!",1*/
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		{0x00,0x02,0x01,0x02,0x02,0x04,0x02,0x00,0x00,0x00,0x00,0x00,0x00,0x00,0x00,0x00},/*"~",94*/

};

static HAL_StatusTypeDef OLED_WriteCmd(uint8_t cmd)
{
    return HAL_I2C_Mem_Write(&hi2c1, OLED_ADDR, 0x00, I2C_MEMADD_SIZE_8BIT, &cmd, 1, 40);
}
static void OLED_WriteData(uint8_t data)
{
    HAL_I2C_Mem_Write(&hi2c1, OLED_ADDR, 0x40, I2C_MEMADD_SIZE_8BIT, &data, 1, 40);
}

void OLED_Init(void)
{
    HAL_Delay(100);
if(OLED_WriteCmd(0xAE)!= HAL_OK)
    {
        // I2C 无应答，程序死循环
        while(1)
        {
            // 可外接LED闪烁提示，这里先死等
        }
    }
    OLED_WriteCmd(0xAE);
    OLED_WriteCmd(0xD5);
    OLED_WriteCmd(0x80);
    OLED_WriteCmd(0xA8);
    OLED_WriteCmd(0x3F);
    OLED_WriteCmd(0xD3);
    OLED_WriteCmd(0x00);
    OLED_WriteCmd(0x40);
    OLED_WriteCmd(0x8D);
    OLED_WriteCmd(0x14);
    OLED_WriteCmd(0x20);
    OLED_WriteCmd(0x02);
    OLED_WriteCmd(0xA1);
    OLED_WriteCmd(0xC8);
    OLED_WriteCmd(0xDA);
    OLED_WriteCmd(0x12);
    OLED_WriteCmd(0x81);
    OLED_WriteCmd(0xCF);
    OLED_WriteCmd(0xD9);
    OLED_WriteCmd(0xF1);
    OLED_WriteCmd(0xDB);
    OLED_WriteCmd(0x30);
    OLED_WriteCmd(0xA4);
    OLED_WriteCmd(0xA6);
    OLED_WriteCmd(0xAF);

    OLED_Clear();
}

void OLED_Clear(void)
{
    uint8_t y, x;
    for(y=0;y<8;y++)
    {
        OLED_WriteCmd(0xB0+y);
        OLED_WriteCmd(0x00);
        OLED_WriteCmd(0x10);
        for(x=0;x<128;x++)
            OLED_WriteData(0x00);
    }
}

void OLED_ShowChar(uint8_t x, uint8_t y, uint8_t chr, uint8_t size)
{
    uint8_t c = 0, i = 0;
    c = chr - ' ';  // 得到字库编号

    // 设置坐标
    OLED_WriteCmd(0xB0 + y);
    OLED_WriteCmd(((x&0xF0)>>4)|0x10);
    OLED_WriteCmd(x&0x0F);

    // 发送上8行
    for(i=0; i<8; i++)
        OLED_WriteData(ascii_code_8x16[c][i]);

    // 切换到下一页
    OLED_WriteCmd(0xB0 + y + 1);
    OLED_WriteCmd(((x&0xF0)>>4)|0x10);
    OLED_WriteCmd(x&0x0F);

    // 发送下8行
    for(i=0; i<8; i++)
        OLED_WriteData(ascii_code_8x16[c][i+8]);
}
void OLED_ShowString(uint8_t x, uint8_t y, char *str, uint8_t size)
{
    // 一个一个字符显示
    while(*str)
    {
        OLED_ShowChar(x, y, *str, size);
        
        x += 8;        // 每个字符占8列
        if(x > 127)    // 超出屏幕宽度自动换行
        {
            x = 0;
            y += 2;    // 每个字符占16行 = 2页
        }
        
        str++;         // 下一个字符
    }
}

void OLED_ShowNum(uint8_t x, uint8_t y, int num, uint8_t len, uint8_t size)
{
    char buf[10];
    sprintf(buf,"%d",num);
    OLED_ShowString(x,y,buf,size);
}

// ===================== 小车专用显示 =====================
void OLED_ShowCarData(int16_t speed_l, int16_t speed_r, int pwm_l, int pwm_r, float kp, float ki, float kd)
{
    char buf[20];

    OLED_Clear();

    // 第0行：速度
    sprintf(buf,"L:%d R:%d", speed_l, speed_r);
    OLED_ShowString(0,0,buf,16);

    // 第2行：PWM
    sprintf(buf,"PWM L:%d R:%d", pwm_l, pwm_r);
    OLED_ShowString(0,2,buf,16);

    // 第4行：PID
    sprintf(buf,"Kp:%.1f", kp);
    OLED_ShowString(0,4,buf,16);

    sprintf(buf,"Ki:%.1f", ki);
    OLED_ShowString(60,4,buf,16);

    sprintf(buf,"Kd:%.1f", kd);
    OLED_ShowString(0,6,buf,16);
}
